## TrafficLight/tools/menuconfig/Kconfig
```kconfig
    menu "App Demo"
        choice APP_DEMO
            prompt "COLORFUL_LIGHT or TRAFFIC_LIGHT or ENVIRONMENTAL_MONITORING or NFC or ALL_DEMO"
            default COLORFUL_LIGHT
            config COLORFUL_LIGHT
                bool "COLORFUL_LIGHT"
                help
                    Set App Demo as COLORFUL_LIGHT.

            config TRAFFIC_LIGHT
                bool "TRAFFIC_LIGHT"
                help
                    Set App Demo as TRAFFIC_LIGHT.
            config ENVIRONMENTAL_MONITORING
                bool "ENVIRONMENTAL_MONITORING"
                help
                    Set App Demo as ENVIRONMENTAL_MONITORING. 
            config NFC
                bool "NFC"
                help
                    Set App Demo as NFC.
            config ALL_DEMO
                bool "ALL_DEMO"
                help
                    Set App Demo as ALL_DEMO.                       
        endchoice
    endmenu

    menu "Target Chip"
        choice TARGET_CHIP
            prompt "Hi3861 or Hi3861L"
            default TARGET_CHIP_HI3861
            config TARGET_CHIP_HI3861
                bool "Hi3861"
                help
                    Set Target Chip as Hi3861.

            config TARGET_CHIP_HI3861L
                bool "Hi3861L"
                help
                    Set Target Chip as Hi3861L.
        endchoice
    endmenu

    menu "Security Settings"
        choice TARGET_SIGNATURE_MOD
            prompt "Signature Algorithm for bootloader and upgrade file"
            default TARGET_SIG_SHA256
            config TARGET_SIG_RSA_V15
                bool "RSA_V15"
                help
                    RSA_V15 Signature Algorithm of bootloader and upgrade file.

            config TARGET_SIG_RSA_PSS
                bool "RSA_PSS"
                help
                    RSA_PSS Signature Algorithm of bootloader and upgrade file.

            config TARGET_SIG_ECC
                bool "ECC"
                help
                    ECC Signature Algorithm of bootloader and upgrade file.

            config TARGET_SIG_SHA256
                bool "SHA256"
                help
                    SHA256 Signature Algorithm of bootloader and upgrade file.
        endchoice

        config BOOT_ENCRYPT
            depends on TARGET_SIG_RSA_PSS || TARGET_SIG_ECC || TARGET_SIG_RSA_V15
            bool "Enable bootloader encryption"
            help
                Enable Bootloader encryption.
        config TARGET_BOOT_VER
            int "boot ver(value form 0 to 16)"
            default 0
            help
                Set boot version.
        config TARGET_KERNEL_VER
            int "kernel ver(value form 0 to 48)"
            default 0
            help
                Set kernel version.
        config TEE_HUKS_SUPPORT
            bool "TEE HUKS support"
            default n
            select FILE_SYSTEM_SUPPORT
            help
                Support TEE HUKS interface.
        config TEE_HUKS_DEMO_SUPPORT
            bool "TEE HUKS demo support"
            default n
            select FILE_SYSTEM_SUPPORT
            select TEE_HUKS_SUPPORT
            help
                Support TEE HUKS DEMO interface.
        config FLASH_ENCRYPT_SUPPORT
            bool "FLASH ENCRYPT support(only apply in WIFI CHIP_PKT_32K)"
            default n
            help
                Support encrypt code and data.
    endmenu

    menu "Factory Test Settings"
        config FACTORY_TEST_SUPPORT
            bool "factory test enable"
            default n
            help
                enable factory test in flashboot.
    endmenu

    menu "BSP Settings"
        config I2C_SUPPORT
            bool "i2c driver support"
            default n
            help
                i2c driver support.

        config I2S_SUPPORT
            bool "i2s driver support"
            default n
            help
                i2s driver support.

        config SPI_SUPPORT
            bool "SPI driver support"
            default n
            help
                spi driver support.

        config DMA_SUPPORT
            bool "DMA driver support"
            default n
            help
                dma driver support.

        config SDIO_SUPPORT
            bool "SDIO driver support"
            default n
            help
                sdio driver support.

        config SPI_DMA_SUPPORT
            bool "SPI support DMA"
            default n
            help
                spi driver support DMA transfer.

        config UART_DMA_SUPPORT
            bool "UART support DMA"
            default n
            help
                uart driver support DMA transfer.

        config PWM_SUPPORT
            bool "PWM driver support"
            default n
            help
                pwm driver support.

        config PWM_HOLD_AFTER_REBOOT
            bool "PWM hold after reboot"
            default n
            help
                pwm hold after reboot.

        config AT_SUPPORT
            bool "Enable AT command"
            default y
            help
                enable at command.
        config FILE_SYSTEM_SUPPORT
            bool "Enable file system"
            default n
            help
                enable file system.
        config UART0_SUPPORT
            bool "Enable uart0 IO mux config"
            default y
            help
                Enable uart0 IO mux config.
        config UART1_SUPPORT
            bool "Enable uart1 IO mux config"
            default y
            help
                Enable uart1 IO mux config.
        config UART2_SUPPORT
            bool "Enable uart2 IO mux config"
            default n
            help
                Enable uart2 IO mux config.
    endmenu

    menu "WiFi Settings"
        config WPS_SUPPORT
            bool "Enable WPS"
            default n
            help
                enable the option to support WPS in WPA.
        choice
            prompt "Authentication Option of Radio Parameters"
            default CE_SUPPORT

            config CE_SUPPORT
            bool "CE Authentication"

            config FCC_SUPPORT
            bool "FCC Authentication"

            config MAX_POWER_SUPPORT
            bool "Max Power"
        endchoice

        config MESH_SUPPORT
            bool "Enable MESH(only apply in WIFI CHIP_PKT_32K)"
            default n
            help
                Enable the option to compile mesh module.

        config WPA3_SUPPORT
            bool "Enable WPA3"
            default n
            help
                enable the option to support WPA3 in WPA.

        config QUICK_SEND_MODE
            bool "Enable quick send mode"
            default n
            help
                Enable quick send mode.
    endmenu

    menu "Third Party library"
        config CJSON
            bool "cJson support"
            default n
            help
                Enable the option to compile cjson module.

        config CJSON_NESTING_LIMIT
            int "cJson nest limit size"
            default 1000
            depends on CJSON
            help
                Cjson nest limit size.

        config LIBCOAP
            bool "COAP support"
            default n
            help
                Enable the option to compile libcoap module.

        config MQTT
            bool "MQTT support"
            default y
            help
                Enable the option to compile mqtt module.

        config IPERF
            bool "iperf support"
            default y
            help
                Enable iperf for network throughput test.
    endmenu

    menu "Lwip Settings"
        config DHCPS_GW
            bool "Enable Option Router (Option3)"
            default y
            help
                enable the option to add router option information.

        config NETIF_HOSTNAME
            bool "Enable DHCP Hostname (Option12)"
            default n
            help
                enable the option to set/get netif hostname.

        config DHCP_VENDOR_CLASS_IDENTIFIER
            bool "Enable DHCP Vendorname (Option60)"
            default n
            help
                enable the option to set/get vendor class identifier information.

        config LWIP_LOWPOWER
            bool "Lwip Support Lowpower Mode"
            default n
            help
                lwip support lowpower mode.
    endmenu

    menu "OTA Settings"
        choice
            prompt "OTA upgrade method"
            default COMPRESSION_OTA_SUPPORT
            config COMPRESSION_OTA_SUPPORT
                bool "compression ota support"
                help
                    compression ota upgrade method.

            config DUAL_PARTITION_OTA_SUPPORT
                bool "dual-partition ota support"
                help
                    dual-patition upgrade method.
        endchoice
    endmenu

    menu "Link Settings"
        config HILINK
            bool "HiLink support"
            default n
            help
                Enable the option to compile hilink module.
        choice LINK        
        prompt "Ocean Connect Support" 
            default LINK_NULL 
            config LINK_NULL
                bool "LINK_NULL"
                help
                    Disable the option to compile histreaming module.   

            config OCEAN_CONNECT_SUPPORT
                bool "Ocean Connect support"
                select MQTT
                select CJSON
                help
                    Enable the option to compile histreaming module.     
        endchoice        

    endmenu

    menu "Debug Log Settings"
        config DIAG_SUPPORT
            bool "Enable debug log"
            default n
            help
                Enable debug log to HSO.
    endmenu
```
